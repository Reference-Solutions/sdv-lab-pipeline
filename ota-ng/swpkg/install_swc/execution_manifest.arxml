AUTOSAR XML (schema 00050)
package /xAAP/UCMS/BT/Executables
  4 x executable:
    user_app: reporting-behavior=DOES-NOT-REPORT-EXECUTION-STATE
      root sw component prototype RootSWVomponentUserApp: application-type=user_app_component
    arapipcd: reporting-behavior=REPORTS-EXECUTION-STATE
    ucm_pkgmanager: reporting-behavior=REPORTS-EXECUTION-STATE
    crypto_daemon: reporting-behavior=REPORTS-EXECUTION-STATE
package /xAAP/UCMS/BT/Processes
  4 x process:
    swp_user_app_1_random_data: executable=user_app
      state-dependent-startup-configs:
        function-group-state=DefaultFG.On, startup-config=user_app_StartupConfig_On
        function-group-state=DefaultFG.Verify, startup-config=user_app_StartupConfig_Verify
    arapipcd: executable=arapipcd, state-dependent-startup-config{function-group-state=[MachineFG.Restart, MachineFG.Shutdown, MachineFG.Startup], startup-config=arapipcd_StartupConfig}
    crypto_daemon: executable=crypto_daemon, state-dependent-startup-config{function-group-state=[MachineFG.Restart, MachineFG.Shutdown, MachineFG.Startup], startup-config=crypto_daemon_StartupConfig}
    ucm_pkgmanager: executable=ucm_pkgmanager, state-dependent-startup-config{function-group-state=[PlatformFG.On, PlatformFG.Verify], startup-config=ucm_pkgmanager_StartupConfig}
package /xAAP/UCMS/BT/StartupConfigs
  5 x startup config:
    user_app_StartupConfig_On: environment-variables=tag-with-optional-value={key=MODE, value=On}
    user_app_StartupConfig_Verify: environment-variables=tag-with-optional-value={key=MODE, value=Verify}
    arapipcd_StartupConfig: environment-variables=tag-with-optional-value={key=LD_LIBRARY_PATH, value=/lib:/usr/lib:/opt/vrte/lib}
    crypto_daemon_StartupConfig: process-arguments=[-k, ecucfg, -c, /opt/vrte/crypto_daemon/data], scheduling-policy=Round Robin, scheduling-priority=1, timeout={enter-timeout-value=30.0, exit-timeout-value=30.0}
      environment-variables:
        key=LD_LIBRARY_PATH, value=/opt/vrte/crypto_daemon/lib:/opt/vrte/lib:/opt/vrte/usr/lib:/usr/lib:/lib:/proc/boot
        key=ECUCFG_ENV_VAR_ROOTFOLDER, value=/opt/vrte/crypto_daemon/etc/ecu-cfg
    ucm_pkgmanager_StartupConfig: process-arguments=[-a, -x, /opt/vrte/ucm-pkgmanager/etc/ucm-pkgmanager.conf], scheduling-policy=First In First Out, scheduling-priority=1, timeout={enter-timeout-value=100.0, exit-timeout-value=100.0}
      environment-variables:
        key=LD_LIBRARY_PATH, value=/opt/vrte/ucm-pkgmanager:/opt/vrte/usr/lib:/opt/vrte/lib:/usr/lib:/lib:/proc/boot
        key=ECUCFG_ENV_VAR_ROOTFOLDER, value=/opt/vrte/ucm-pkgmanager/etc/ecu-cfg
package /xAAP/UCMS/BT/ProcessToMachineMappings
  process to machine mapping set execution_manifest_ProcessToMachineMappingSet
    process to machine mapping Process_Machine_Mapping: machine=Machine, process=swp_user_app_1_random_data
    process to machine mapping crypto_daemon_Machine_Mapping: machine=Machine, process=crypto_daemon
    process to machine mapping ucm_pkgmanager_Machine_Mapping: machine=Machine, process=ucm_pkgmanager
