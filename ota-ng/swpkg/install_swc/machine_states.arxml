AUTOSAR XML (schema 00050)
package /xAAP/UCMS/BT/ModeDeclarationGroups
  mode declaration group DefaultFG: initial-mode=DefaultFG/Off
    4 x mode:
      Off
      On
      Calibrate
      Verify
  mode declaration group MachineFG: initial-mode=MachineFG/Off
    6 x mode:
      Off
      Restart
      Shutdown
      Startup
      ShutdownOS
      RestartOS
  mode declaration group PlatformFG: initial-mode=PlatformFG/Off
    mode Off
    mode On
    mode Verify
package /xAAP/UCMS/BT/FunctionGroupSet
  function group set FunctionGroupSet
    function-groups:
      mode declaration group prototype DefaultFG: type=DefaultFG
      mode declaration group prototype MachineFG: type=MachineFG
      mode declaration group prototype PlatformFG: type=PlatformFG
