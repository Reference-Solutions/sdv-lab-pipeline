AUTOSAR XML (schema 00050)
# xAAP/UCMS/BT/SoftwareClusters/License
package /xAAP/UCMS/BT/SoftwareClusters
  software cluster __APP_PACKAGE_NAME__: category=APPLICATION_LAYER, claimed-function-group=DefaultFG, contained-process=swp_user_app_1_random_data, license=License, release-notes=ReleaseNotes, type-approval=India, vendor-id=11, version=__APP_VERSION__
