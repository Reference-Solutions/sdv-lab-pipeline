AUTOSAR XML (schema 00050)
package /xAAP/UCMS/BT/Persistency/PersistencyKeyValueStorages
  persistency key value storage user_app_component_KeyValueStorage_PKVS: minimum-sustained-size=64, update-strategy=KEEP-EXISTING, version=1.0.0-0, uri=/opt/vrte/user_app/data
    persistency key value pair app_id: update-strategy=OVERWRITE, init-value=swc2, value-data-type=string
package /xAAP/UCMS/BT/Persistency/PersistencyPortPrototypeToKeyValueStorageMappings
  persistency port prototype to key value storage mapping user_app_component_KeyValueStorage_MAPPING: port-prototype=RootSWVomponentUserApp.KeyValueStorage, process=swp_user_app_1_random_data, key-value-storage=user_app_component_KeyValueStorage_PKVS
