AUTOSAR XML (schema 00050)
package /xAAP/UCMS/BT/Persistency/AppDesign/SWComponent
  adaptive application sw component type user_app_component
    require port KeyValueStorage: persistency-data-required-com-spec{data-element=app_id, init-value=swc2}, required-interface=iKeyValueStorage
package /xAAP/UCMS/BT/Persistency/AppDesign/Interfaces/iKeyValueStorage
  persistency key value storage interface iKeyValueStorage: minimum-sustained-size=64, redundancy=NONE, update-strategy=KEEP-EXISTING
    persistency data element app_id: type=string, update-strategy=OVERWRITE
