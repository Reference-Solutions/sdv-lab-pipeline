AUTOSAR XML (schema 00050)
package /xAAP/UCMS/BT
  machine Machine: machine-design=MachineDesign
    ucm module instantiation UcmModuleInstantiation: identifier=1, max-number-of-parallel-transfers=4, ucm-software-version=2.7.0.0
    crypto module instantiation CryptoModuleInstantiation
      crypto provider WOLFCRYPT_PROVIDER
  machine design MachineDesign
