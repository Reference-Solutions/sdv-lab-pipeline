AUTOSAR XML (schema 00050)
package /xAAP/UCMS/BT/SoftwarePackage
  software package install_swc_app: category=APPLICATION_LAYER, action-type=INSTALL, activation-action=RESTART-APPLICATION, compressed-software-package-size=0, estimated-duration-of-operation=0.0, minimum-supported-ucm-version=2.7.0.0, packager-id=11, software-cluster=install_swc_app, uncompressed-software-cluster-size=0
