AUTOSAR XML (schema 00050)
package /xAAP/UCMS/BT/SoftwarePackage
  software package __APP_PACKAGE_NAME__: category=APPLICATION_LAYER, action-type=__ACTION_TYPE__, activation-action=RESTART-APPLICATION, compressed-software-package-size=0, estimated-duration-of-operation=0.0, minimum-supported-ucm-version=2.7.0.0, packager-id=11, software-cluster=__APP_PACKAGE_NAME__, uncompressed-software-cluster-size=0
