AUTOSAR XML (schema 00050)
package /xAAP/UCMS/BT/SoftwareClusters
  documentation ReleaseNotes
  documentation License
