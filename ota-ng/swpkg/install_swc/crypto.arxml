AUTOSAR XML (schema 00050)
package /xAAP/UCMS/BT/Crypto
  adaptive application sw component type SWComponentUCMS
    require port RPortCryptoProvider: required-interface=CryptoProviderInterface
  crypto provider interface CryptoProviderInterface: is-service=true, service-kind=CRYPTO-SERVICE-MANAGER
  crypto provider to port prototype mapping CryptoProviderToPortPrototypeMapping: crypto-provider=WOLFCRYPT_PROVIDER, process=ucm_pkgmanager
